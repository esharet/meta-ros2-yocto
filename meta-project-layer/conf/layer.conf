## meta-project-layer/conf/layer.conf
```bitbake
# We have a conf and classes directory, add to BBPATH
BBPATH =. "${LAYERDIR}:"

# We have recipes-* directories, add to BBFILES
BBFILES += "${LAYERDIR}/recipes-*/*/*.bb \
            ${LAYERDIR}/recipes-*/*/*.bbappend"

BBFILE_COLLECTIONS += "meta-project-layer"
BBFILE_PATTERN_meta-project-layer= "^${LAYERDIR}/"
BBFILE_PRIORITY_meta-project-layer = "5"

LAYERSERIES_COMPAT_meta-project-layer = "hardknott"

# This should only be incremented on significant changes that will
# cause compatibility issues with other layers
LAYERVERSION_meta-project-layer = "3"

LAYERDEPENDS_meta-project-layer = "core"
```
